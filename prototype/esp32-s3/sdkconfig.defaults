## prototype/esp32-s3/sdkconfig.defaults
```kconfig
CONFIG_IDF_TARGET="esp32s3"
CONFIG_CODEC_I2C_BACKWARD_COMPATIBLE=n
CONFIG_SPIRAM=y
CONFIG_SPIRAM_SPEED_80M=y
CONFIG_SPIRAM_USE_MEMMAP=y
CONFIG_SPIRAM_MODE_OCT=y
```
